## drivers/gpu/arm/mali/Kconfig
```kconfig
config MALI400
	tristate "Mali-300/400/450 support"
	depends on ARM
	default y
	select DMA_SHARED_BUFFER
	---help---
	  This enables support for the ARM Mali-300, Mali-400, and Mali-450
	  GPUs.

	  To compile this driver as a module, choose M here: the module will be
	  called mali.

config MALI400_DEBUG
	bool "Enable debug in Mali driver"
	depends on MALI400
	---help---
	  This enabled extra debug checks and messages in the Mali driver.

config MALI400_UMP
	bool "Enable UMP support"
	depends on MALI400
	---help---
	  This enables support for the UMP memory sharing API in the Mali driver.

config MALI_DVFS
	bool "MALI DVFS"
	depends on MALI400 && REGULATOR
	default y
	help
	  This enables Mali driver DVFS.
```

## drivers/hardkernel/Kconfig
```kconfig
config HKDK4412_TMU
	bool "Hardkernel's ODROID(X/Q) TMU Hack"
	default y
	help
	This is hack to support TMU on ODROID-X/Q running Ubuntu.
	Its strongly recommended to Enable this.
	Otherwise you'll experience system freezes due to high cpu
	temperature
```

## drivers/staging/omap3-sgx/Kconfig
```kconfig
#
# SGX Driver Support
#

config OMAP3_SGX
	bool "OMAP3 SGX support (TI: 4.03.00.02)"
	depends on OMAP2_DSS && m
	help
	  This is TI's OMAP3 SGX Kernel Modules 4.03.00.02
```

## fs/zfs/Kconfig
```kconfig
config ZFS
	tristate "ZFS filesystem support"
	depends on SPL
	depends on EFI_PARTITION
	select ZLIB_INFLATE
	select ZLIB_DEFLATE
	help
	  This is the ZFS filesystem from the ZFS On Linux project.

	  See http://zfsonlinux.org/

	  To compile this file system support as a module, choose M here.

	  If unsure, say N.
```

## spl/Kconfig
```kconfig
config SPL
	tristate "Solaris Porting Layer (SPL)"
	help
	  This is the SPL library from the ZFS On Linux project.

	  See http://zfsonlinux.org/

	  To compile this library as a module, choose M here.

	  If unsure, say N.
```
